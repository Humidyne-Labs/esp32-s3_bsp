## Kconfig
```kconfig
menu "ESP32-S3 Touch ePaper Board Support Package"

    config BSP_BOARD_NAME
        string "Board Name"
        default "ESP32-S3 Touch ePaper 1.54 inch"
        help
            Identifier for the board target.

    config BSP_ENABLE_TOUCH
        bool "Enable touch panel"
        default y
        help
            Initialize the FT6336 touch controller and expose it to LVGL.

    menu "Pinout Configuration"

        config BSP_GPIO_BOOT_KEY
            int "BOOT Switch GPIO"
            default 0

        config BSP_GPIO_USER_LED
            int "User Status LED GPIO"
            default 3

        config BSP_GPIO_BAT_ADC
            int "Battery ADC GPIO"
            default 4

        config BSP_GPIO_BAT_CTRL
            int "Battery Control GPIO"
            default 17

        config BSP_GPIO_BAT_KEY
            int "Battery Key Switch GPIO"
            default 18

        config BSP_GPIO_RTC_INT
            int "RTC Interrupt GPIO"
            default 5

        config BSP_GPIO_I2C_SCL
            int "Shared I2C SCL GPIO"
            default 48

        config BSP_GPIO_I2C_SDA
            int "Shared I2C SDA GPIO"
            default 47

        config BSP_GPIO_EPD_3V3_EN
            int "Display 3V3 Power Enable GPIO"
            default 6

        config BSP_GPIO_EPD_DC
            int "Display DC Control GPIO"
            default 10

        config BSP_GPIO_EPD_RST
            int "Display Reset GPIO"
            default 9

        config BSP_GPIO_EPD_CS
            int "Display SPI Chip Select GPIO"
            default 11

        config BSP_GPIO_EPD_SCLK
            int "Display SPI Clock GPIO"
            default 12

        config BSP_GPIO_EPD_MOSI
            int "Display SPI MOSI (SDI) GPIO"
            default 13

        config BSP_GPIO_EPD_BUSY
            int "Display Busy Status GPIO"
            default 8

        config BSP_GPIO_TOUCH_RST
            int "Touch Panel Reset GPIO"
            default 7

        config BSP_GPIO_TOUCH_INT
            int "Touch Panel Interrupt GPIO"
            default 21

        config BSP_GPIO_SD_CLK
            int "MicroSD Clock GPIO"
            default 39

        config BSP_GPIO_SD_MISO
            int "MicroSD MISO GPIO"
            default 40

        config BSP_GPIO_SD_MOSI
            int "MicroSD MOSI GPIO"
            default 41

        config BSP_GPIO_I2S_MCLK
            int "Audio Codec MCLK GPIO"
            default 14

        config BSP_GPIO_I2S_SCLK
            int "Audio Codec SCLK GPIO"
            default 15

        config BSP_GPIO_I2S_LRCK
            int "Audio Codec LRCK GPIO"
            default 38

        config BSP_GPIO_I2S_ASOUT
            int "Audio Codec ASOUT GPIO"
            default 16

        config BSP_GPIO_I2S_DSIN
            int "Audio Codec DSIN GPIO"
            default 45

        config BSP_GPIO_PA_CTRL
            int "Power Amplifier Control GPIO"
            default 46

        config BSP_GPIO_PA_EN
            int "Power Amplifier Enable GPIO"
            default 42

    endmenu

endmenu
```

## components/esp32-s3_bsp/Kconfig
```kconfig
menu "ESP32-S3 ePaper Board Support Package"

    config BSP_BOARD_NAME
        string "Board Name"
        default "Waveshare ESP32-S3 ePaper 1.54 V2"
        help
            Identifier for the board target.

    config BSP_AUDIO_DEFAULT_VOLUME
        int "Default Audio Volume Percentage (0-100)"
        range 0 100
        default 80
        help
            Default startup volume level for the ES8311 codec and NS4168 amplifier.

    config BSP_AUDIO_LOW_POWER_DEFAULT
        bool "Enable ES8311 Low-Power Playback Mode by Default"
        default y
        help
            Enables low power mode on the ES8311 DAC during active playback (Reg 0x0F LPDAC & LPDACVRP bits).
            Reduces active audio current consumption by ~30% while preserving audio quality.

    config BSP_BATTERY_CORRECTION_FACTOR_MV
        int "Battery ADC Voltage Correction Factor (mV)"
        range 0 500
        default 50
        help
            Voltage offset correction factor in millivolts added to battery ADC readings
            to compensate for resistor divider tolerance and hardware calibration offsets.




    choice BSP_RTC_WAKEUP_SOURCE
        prompt "Deep Sleep Wakeup Timer Source"
        default BSP_RTC_WAKEUP_EXTERNAL_PCF85063
        help
            Select the timer source used for timed deep-sleep wakeups.
            External PCF85063A uses an ultra-low power 32.768kHz crystal (~0.22uA) and wakes up via GPIO 5 interrupt.
            Internal RTC Timer uses the ESP32-S3 internal RTC timer (~7-8uA).

        config BSP_RTC_WAKEUP_EXTERNAL_PCF85063
            bool "External PCF85063A RTC Countdown Timer (0.22uA, Recommended for Battery Life)"
            help
                Uses the external PCF85063A RTC periodic countdown timer on GPIO 5 (RTC_INT)
                to trigger wakeups. Best for preserving battery life on 400mAh cells.

        config BSP_RTC_WAKEUP_INTERNAL_TIMER
            bool "ESP32-S3 Internal RTC Timer (esp_sleep_enable_timer_wakeup)"
            help
                Uses the ESP32-S3 internal sleep timer. Useful if external RTC is unpopulated
                or for sub-second sleep precision.
    endchoice

    config BSP_ENABLE_THINGSBOARD
        bool "Enable ThingsBoard IoT Telemetry & MQTT Client (bsp_tb)"
        default n
        help
            Enable ThingsBoard client module (bsp_tb.c/h) and MQTT dependency.
            Disabled by default to minimize binary size and memory footprint.

    config BSP_THERMAL_COMPENSATION_DEFAULT
        bool "Enable Dynamic MCU Thermal & Humidity Compensation by Default"
        default y
        help
            Uses the ESP32-S3 internal die temperature sensor (TSENS) to compensate SHTC3
            temperature and relative humidity for PCB self-heating.

    config BSP_THERMAL_DIVIDER_K_X1000
        int "Thermal Coupling Ratio K (x1000)"
        range 0 2000
        default 380
        depends on BSP_THERMAL_COMPENSATION_DEFAULT
        help
            Thermal resistance coupling ratio K = R_amb / R_pcb multiplied by 1000.
            Default 380 represents K = 0.380, calibrated for 53mm x 40mm 4-6 layer PCB stackup.

    config BSP_THERMAL_EMA_ALPHA_X1000
        int "MCU Die Temp EMA Filter Weight Alpha (x1000)"
        range 1 1000
        default 50
        depends on BSP_THERMAL_COMPENSATION_DEFAULT
        help
            Exponential Moving Average (EMA) low-pass filter weight multiplied by 1000.
            Default 50 represents alpha = 0.050 (low-pass filter to smooth CPU junction thermal spikes).

endmenu
```

## examples/Unified_BSP_Demo/main/Kconfig.projbuild
```kconfig
menu "Unified BSP Demo Configuration"

    config DEMO_DEBUG_BYPASS_PROV
        bool "Bypass Provisioning & Force Live Telemetry Dashboard (Debug Mode)"
        default n
        help
            When enabled (or when the BOOT button is held down at power-up),
            the firmware skips BLE provisioning and claiming token flows,
            and boots directly into the active telemetry dashboard with live sensor polling.

    config DEMO_DEBUG_DISABLE_DEEP_SLEEP
        bool "Disable Deep Sleep in Debug Mode (Continuous Bench Testing)"
        default y
        help
            Keeps the ESP32-S3 awake continuously during debug/testing mode so you can
            test touch interaction and live sensor polling without entering deep sleep.

    choice DEMO_SLEEP_MODE
        prompt "Telemetry Sleep Architecture"
        default DEMO_SLEEP_MODE_LIGHT
        help
            Select the default sleep architecture for the telemetry node.
            Can also be overridden dynamically via ThingsBoard shared attribute "sleep_mode".

        config DEMO_SLEEP_MODE_LIGHT
            bool "Light Sleep (Zero re-init, resumes execution on same line)"
            help
                Retains CPU state, FreeRTOS tasks, and all RAM in memory.
                Wakes instantly at the exact line of code without resetting or reinitializing.

        config DEMO_SLEEP_MODE_DEEP
            bool "Deep Sleep (Ultra-low power with Fast-Wake path)"
            help
                Powers down the CPU and digital core (~10uA). Wakes via fast-boot
                path skipping audio, SD, and unneeded peripheral initialization.
    endchoice

endmenu
```

## examples/Unified_BSP_Demo/sdkconfig.defaults
```kconfig
# Target ESP32-S3 PICO-1-N8R8 Configuration (8MB Flash QSPI, 8MB PSRAM Octal)
CONFIG_IDF_TARGET="esp32s3"
CONFIG_ESP_DEFAULT_CPU_FREQ_MHZ_240=y
CONFIG_ESP_DEFAULT_CPU_FREQ_MHZ=240

# BSP
CONFIG_BSP_SHTC3_LOW_POWER=y
CONFIG_BSP_ENABLE_TOUCH=n

# Codec
CONFIG_CODEC_ES8311_SUPPORT=y

# LVGL
CONFIG_LV_COLOR_FORMAT_I1=y
CONFIG_LV_COLOR_DEPTH_1=y
CONFIG_LV_COLOR_DEPTH=1
CONFIG_LV_DRAW_SW_SUPPORT_I1=y
CONFIG_LV_USE_THEME_MONO=y
CONFIG_LV_DPI_DEF=188

# Flash settings (8MB)
CONFIG_ESPTOOLPY_FLASHSIZE_8MB=y
CONFIG_ESPTOOLPY_FLASHSIZE="8MB"
CONFIG_ESPTOOLPY_FLASHMODE_QIO=y
CONFIG_ESPTOOLPY_FLASHFREQ_80M=y

# PSRAM settings (8MB Octal SPI)
CONFIG_SPIRAM=y
CONFIG_SPIRAM_MODE_OCT=y
CONFIG_SPIRAM_SPEED_80M=y
CONFIG_SPIRAM_USE_MALLOC=y

# Custom Partition Table (Dual OTA)
CONFIG_PARTITION_TABLE_CUSTOM=y
CONFIG_PARTITION_TABLE_CUSTOM_FILENAME="partitions.csv"
CONFIG_PARTITION_TABLE_FILENAME="partitions.csv"

# FreeRTOS Clock Rate
CONFIG_FREERTOS_HZ=1000

# Bluetooth & BLE Provisioning (GATT Scheme for Web Dashboard)
CONFIG_BT_ENABLED=y
CONFIG_BT_NIMBLE_ENABLED=y
CONFIG_BT_NIMBLE_NVS_PERSIST=y
CONFIG_WIFI_PROV_SCHEME_BLE=y
CONFIG_WIFI_PROV_AUTOSTOP_TIMEOUT=60

# HTTP & OTA Updates
CONFIG_ESP_HTTPS_OTA_DECRYPT_CB=n
CONFIG_ESP_TLS_USING_MBEDTLS=y
```

## examples/bsp_power_example/sdkconfig.defaults
```kconfig
# Target Architecture
CONFIG_IDF_TARGET="esp32s3"
CONFIG_ESP_DEFAULT_CPU_FREQ_MHZ_240=y
CONFIG_ESP_DEFAULT_CPU_FREQ_MHZ=240

# BSP Configuration
CONFIG_BSP_SHTC3_LOW_POWER=y
CONFIG_BSP_AUDIO_DEFAULT_VOLUME=80

# Audio Codec
CONFIG_CODEC_ES8311_SUPPORT=y

# LVGL v9 Graphics Engine
CONFIG_LV_COLOR_DEPTH_1=y
CONFIG_LV_COLOR_DEPTH=1
CONFIG_LV_DRAW_SW_SUPPORT_I1=y
CONFIG_LV_DPI_DEF=188
CONFIG_LV_MEM_CUSTOM=y
CONFIG_LV_FONT_MONTSERRAT_14=y
CONFIG_LV_FONT_DEFAULT_MONTSERRAT_14=y
CONFIG_LV_USE_QRCODE=y
CONFIG_LV_USE_LABEL=y
CONFIG_LV_USE_BUTTON=y
CONFIG_LV_USE_LINE=y
CONFIG_LV_USE_IMAGE=y
CONFIG_LV_USE_THEME_MONO=y
CONFIG_LV_USE_THEME_SIMPLE=y

# 8MB Flash & 8MB Octal PSRAM
CONFIG_ESPTOOLPY_FLASHSIZE_8MB=y
CONFIG_ESPTOOLPY_FLASHSIZE="8MB"
CONFIG_ESPTOOLPY_FLASHMODE_QIO=y
CONFIG_ESPTOOLPY_FLASHFREQ_80M=y
CONFIG_SPIRAM=y
CONFIG_SPIRAM_MODE_OCT=y
CONFIG_SPIRAM_SPEED_80M=y
CONFIG_SPIRAM_USE_MALLOC=y

# Custom Partition Table
CONFIG_PARTITION_TABLE_CUSTOM=y
CONFIG_PARTITION_TABLE_CUSTOM_FILENAME="partitions.csv"
CONFIG_PARTITION_TABLE_FILENAME="partitions.csv"

# FreeRTOS & Dual-Core Affinity
CONFIG_FREERTOS_HZ=1000
CONFIG_FREERTOS_UNICORE=n
CONFIG_ESP_WIFI_TASK_PINNED_TO_CORE_0=y
CONFIG_BT_NIMBLE_PINNED_TO_CORE_0=y

# Bluetooth & NimBLE Provisioning
CONFIG_BT_ENABLED=y
CONFIG_BT_NIMBLE_ENABLED=y
CONFIG_BT_NIMBLE_NVS_PERSIST=y
CONFIG_WIFI_PROV_SCHEME_BLE=y
CONFIG_ESP_PROTOCOMM_SUPPORT_SECURITY_VERSION_0=y
CONFIG_ESP_PROTOCOMM_SUPPORT_SECURITY_VERSION_1=y
CONFIG_ESP_PROTOCOMM_SUPPORT_SECURITY_VERSION_2=y

# TLS & Cert Bundle
CONFIG_MBEDTLS_CERTIFICATE_BUNDLE=y
CONFIG_MBEDTLS_CERTIFICATE_BUNDLE_DEFAULT_FULL=y
```
